## app/boards/my_board/Kconfig.my_board
```kconfig
# Copyright (c) 2024 Renesas Electronics Corporation
# SPDX-License-Identifier: Apache-2.0

config BOARD_MY_BOARD
	select SOC_R7FA8D1BHECBD
```

## app/boards/my_board/board.yml
```yaml
board:
  name: my_board
  full_name: My Board
  vendor: babis
  socs:
  - name: r7fa8d1bhecbd
```

## app/boards/my_board_task2/Kconfig.defconfig
```kconfig
# Copyright (c) 2024-2025 Renesas Electronics Corporation
# SPDX-License-Identifier: Apache-2.0

if BOARD_MY_BOARD_TASK2

configdefault NET_L2_ETHERNET
	default y

endif # BOARD_MY_BOARD_TASK2
```

## app/boards/my_board_task2/board.yml
```yaml
board:
  name: my_board_task2
  full_name: My Board From Scratch
  vendor: babis
  socs:
  - name: r7fa8d1bhecbd
```
